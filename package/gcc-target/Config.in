## package/gcc-target/Config.in
```kconfig
config BR2_PACKAGE_GCC_TARGET
    bool "gcc"
    depends on BR2_TOOLCHAIN_BUILDROOT
    select BR2_PACKAGE_BINUTILS
    select BR2_PACKAGE_BINUTILS_TARGET
    select BR2_PACKAGE_GMP
    select BR2_PACKAGE_MPFR
    select BR2_PACKAGE_MPC
    help
      By default buildroot does not install gcc in the target. This package installs it
      on the target so it can be used on the images.

config BR2_EXTRA_TARGET_GCC_CONFIG_OPTIONS
    string "Additional target gcc options"
    default ""
    depends on BR2_PACKAGE_GCC_TARGET
    help
      Any additional target gcc options you may want to include.
```

## package/python-progressbar2/Config.in
```kconfig
config BR2_PACKAGE_PYTHON_PROGRESSBAR2
	bool "python-progressbar2"
	select BR2_PACKAGE_PYTHON_UTILS # runtime
	help
	  A text progress bar is typically used to display the progress of a long running
	  operation, providing a visual cue that processing is underway.

	  https://github.com/WoLpH/python-progressbar
```

## package/python-rpm/Config.in
```kconfig
config BR2_PACKAGE_PYTHON_RPM
	bool "python-rpm"
	select BR2_PACKAGE_PYTHON_SETUPTOOLS_SCM
	help
	  Shim RPM module for use in virtualenvs.

	  https://github.com/packit/rpm-shim
```

## package/python-utils/Config.in
```kconfig
config BR2_PACKAGE_PYTHON_UTILS
	bool "python-utils"
	select BR2_PACKAGE_PYTHON_TYPING_EXTENSIONS # runtime
	help
	  Python Utils is a module with some convenient utilities not
	  included with the standard Python install.

	  https://github.com/WoLpH/python-utils
```

## package/rpmdevtools/Config.in
```kconfig
config BR2_PACKAGE_RPMDEVTOOLS
	bool "rpmdevtools"
	select BR2_PACKAGE_HELP2MAN
	select BR2_PACKAGE_PYTHON_RPM
	select BR2_PACKAGE_PYTHON_UTILS
	help
	  This package contains scripts and Emacs support files to aid in
	  development of RPM packages.

	  https://pagure.io/rpmdevtools
```
