## package/help2man/Config.in
```kconfig
config BR2_PACKAGE_HELP2MAN
	bool "help2man"
	select BR2_PACKAGE_PERL
	help
	  help2man is a script to create simple man pages from the --help and
	  --version output of programs.

	  https://www.gnu.org/software/help2man/
```

## package/python-setuptools-scm/Config.in
```kconfig
config BR2_PACKAGE_PYTHON_SETUPTOOLS_SCM
	bool "python-setuptools-scm"
	select BR2_PACKAGE_PYTHON_SETUPTOOLS
	help
	  Download, build, install, upgrade, and uninstall Python
	  packages.

	  http://pypi.python.org/pypi/setuptools-scm
```

## package/rpmdevtools/Config.in.host
```kconfig
config BR2_PACKAGE_RPMDEVTOOLS
	bool "rpmdevtools"
	select BR2_PACKAGE_HELP2MAN
	help
	  This package contains scripts and Emacs support files to aid in
	  development of RPM packages.

	  https://pagure.io/rpmdevtools
```
